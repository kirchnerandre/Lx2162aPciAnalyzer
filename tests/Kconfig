## tests/Kconfig
```kconfig
config PCID3GOOD
    bool
    default y if TEST_DEVICES
    depends on PCI_EXPRESS && MSI_NONBROKEN
```

## tests/lx2162a_device/Kconfig
```kconfig
config CONFIG_LX2162A_DEVICE
    bool
    default y if TEST_DEVICES
    depends on PCI_EXPRESS && MSI_NONBROKEN
```

## tests/lx2162a_device_2/Kconfig
```kconfig
config CONFIG_LX2162A_DEVICE_2
    bool
    default y if TEST_DEVICES
    depends on PCI_EXPRESS && MSI_NONBROKEN
```

## tests/lx2162a_pci_device/Kconfig
```kconfig
config LX2162A_PCI_DEVICE
    bool
    default y if TEST_DEVICES
    depends on PCI_EXPRESS && MSI_NONBROKEN
```
